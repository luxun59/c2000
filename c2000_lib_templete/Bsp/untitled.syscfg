/**
 * @cliArgs --board "/boards/LAUNCHXL_F280049C" --product "C2000WARE@4.01.00.00"
 * @versions {"tool":"1.13.0+2553"}
 */

/**
 * Import the modules used in this configuration.
 */
const gpio  = scripting.addModule("/driverlib/gpio.js", {}, false);
const gpio1 = gpio.addInstance();

/**
 * Write custom configuration values to the imported modules.
 */
gpio1.$hardware         = system.deviceData.board.components.LED4;
gpio1.$name             = "MYLED4";
gpio1.direction         = "GPIO_DIR_MODE_OUT";
gpio1.writeInitialValue = true;
gpio1.gpioPin.$assign   = "boosterpack1.12";
